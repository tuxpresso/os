## tuxpresso/package/apid/Config.in
```kconfig
config BR2_PACKAGE_APID
    bool "apid"
    depends on BR2_PACKAGE_HOST_RUSTC_TARGET_ARCH_SUPPORTS
    select BR2_PACKAGE_HOST_RUSTC
    help
      API service for tuxpresso
```

## tuxpresso/package/boilerd/Config.in
```kconfig
config BR2_PACKAGE_BOILERD
    bool "boilerd"
    depends on BR2_PACKAGE_PIDC
    help
      Boiler control service for tuxpresso
```

## tuxpresso/package/ctrld/Config.in
```kconfig
config BR2_PACKAGE_CTRLD
    bool "ctrld"
    depends on BR2_PACKAGE_HOST_RUSTC_TARGET_ARCH_SUPPORTS
    select BR2_PACKAGE_HOST_RUSTC
    help
      Control service for tuxpresso
```

## tuxpresso/package/mcp9600/Config.in
```kconfig
config BR2_PACKAGE_MCP9600
    bool "mcp9600"
    depends on BR2_LINUX_KERNEL
    help
      A driver for the MCP9600 thermocouple EMF converter
```

## tuxpresso/package/pidc/Config.in
```kconfig
config BR2_PACKAGE_PIDC
    bool "pidc"
    help
      A pid controller library

      https://github.com/ahepp/pidc
```

## tuxpresso/package/pwmd/Config.in
```kconfig
config BR2_PACKAGE_PWMD
    bool "pwmd"
    depends on BR2_PACKAGE_HOST_RUSTC_TARGET_ARCH_SUPPORTS
    select BR2_PACKAGE_HOST_RUSTC
    help
      PWM service for tuxpresso
```

## tuxpresso/package/tuxpresso-boilerd/Config.in
```kconfig
config BR2_PACKAGE_TUXPRESSO_BOILERD
    bool "tuxpresso-boilerd"
    depends on BR2_PACKAGE_PIDC
    help
      Boiler control service for tuxpresso
```
